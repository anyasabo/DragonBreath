## components/pb_heater/Kconfig
```kconfig
menu "DragonBreath heater"

config PB_FIRST_HEAT_REPORT_ONLY
    bool "First-heat check: report only, never latch"
    default n
    help
        If disabled (the default), a "wrong roles" or "no rise" result of the
        first-heat check latches the heater off (see docs/SAFETY.md). If
        enabled, the check only reports its result in the API and never
        latches or stores a result. Enable it only to recover from a false trip
        on a unit that you checked by hand. There is no runtime toggle. A safe
        dev-board build always reports only. The option is inverted on purpose:
        a build that does not know the option enforces the check.

endmenu
```

## components/pb_httpd/Kconfig
```kconfig
menu "DragonBreath HTTP API security"

    config DB_REQUIRE_CONTROL_TOKEN
        bool "Require a control token for LAN control and OTA"
        default n
        help
            If n (default), a device with no control token accepts any non-empty
            X-DragonBreath-Auth header (a CSRF gate only).

            If y, a device with no control token refuses the mutating API routes
            and OTA with HTTP 403 token_required. One exception: a request
            that arrives on the setup AP address while the Wi-Fi station is
            not associated (first setup, or a failed join) gets the CSRF gate
            only. Set the first token there: the setup form "Control token"
            field, or POST /api/v2/token. A stored token cannot be cleared.
            A person in radio range with the setup AP password can also set
            the first token, so change the AP password.

    config DB_AUTH_LOCKOUT
        bool "Lock out auth after repeated wrong tokens"
        default n
        help
            If y, after DB_AUTH_LOCKOUT_MAX_FAILS wrong tokens inside
            DB_AUTH_LOCKOUT_WINDOW_S seconds, every auth check fails for
            DB_AUTH_LOCKOUT_DURATION_S seconds (HTTP 429 auth_locked on API v2
            routes, HTTP 403 on the shared portal routes). The
            limit is global and RAM-only. It counts only a wrong token, not
            a missing header. During a lockout, legitimate clients also fail,
            so a remote heat lease can expire and the heater turns off.
            Front-panel buttons and the control loop are not affected.

    config DB_AUTH_LOCKOUT_MAX_FAILS
        int "Wrong tokens before a lockout"
        depends on DB_AUTH_LOCKOUT
        range 3 100
        default 10

    config DB_AUTH_LOCKOUT_WINDOW_S
        int "Window for counting wrong tokens (s)"
        depends on DB_AUTH_LOCKOUT
        range 10 3600
        default 60

    config DB_AUTH_LOCKOUT_DURATION_S
        int "Lockout duration (s)"
        depends on DB_AUTH_LOCKOUT
        range 5 3600
        default 60

endmenu
```

## main/Kconfig.projbuild
```kconfig
menu "DragonBreath Wi-Fi defaults"

    choice DB_DEFAULT_AP_MODE
        prompt "Setup AP mode for a device with no stored AP mode"
        default DB_DEFAULT_AP_MODE_ALWAYS
        help
            The setup AP mode that a device uses when NVS has no AP mode
            (a new device, a device that never changed the AP mode, or a device
            after a front-panel or factory reset). A stored user choice always
            wins. With no saved Wi-Fi credentials, the setup AP is always on,
            whatever this mode is.

            ALWAYS (default) does not write NVS: dc_wifi uses its own default.
            The other choices write the "ap_mode" NVS key once, before
            dc_wifi_start().

        config DB_DEFAULT_AP_MODE_ALWAYS
            bool "Always: the setup AP stays on next to the Wi-Fi station"
        config DB_DEFAULT_AP_MODE_TEMP
            bool "Temporary: the setup AP stays on for 15 minutes after boot"
        config DB_DEFAULT_AP_MODE_FALLBACK
            bool "Fallback: the setup AP starts only if the station cannot join"
        config DB_DEFAULT_AP_MODE_OFF
            bool "Off: no setup AP while credentials are stored"
            help
                If the station cannot join, there is no setup AP. To recover,
                hold Power + Auto for 5 s, or erase NVS over USB.
    endchoice

endmenu
```
